## board/rockchip/mcam/Kconfig
```kconfig
if TARGET_MCAM

config SYS_BOARD
	default "mcam"

config SYS_VENDOR
	default "rockchip"

config SYS_CONFIG_NAME
	default "mcam"

config BOARD_SPECIFIC_OPTIONS
	def_bool y

endif
```

## board/rockchip/sy2223/Kconfig
```kconfig
if TARGET_SY2223

config SYS_BOARD
	default "sy2223"

config SYS_VENDOR
	default "rockchip"

config SYS_CONFIG_NAME
	default "sy2223"

config BOARD_SPECIFIC_OPTIONS
	def_bool y

endif
```
